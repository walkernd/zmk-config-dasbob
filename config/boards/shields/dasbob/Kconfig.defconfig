## config/boards/shields/dasbob/Kconfig.defconfig
```kconfig
# Copyright (c) 2021 The ZMK Contributors
# SPDX-License-Identifier: MIT

if SHIELD_dasbob_left

config ZMK_KEYBOARD_NAME
	default "dasbob"

config ZMK_SPLIT_ROLE_CENTRAL
	default y

endif

if SHIELD_dasbob_left || SHIELD_dasbob_right

config ZMK_SPLIT
	default y

endif
```

## config/boards/shields/dasbob/Kconfig.shield
```kconfig
# Copyright (c) 2021 The ZMK Contributors
# SPDX-License-Identifier: MIT

config SHIELD_dasbob_LEFT
	def_bool $(shields_list_contains,dasbob_left)

config SHIELD_dasbob_RIGHT
	def_bool $(shields_list_contains,dasbob_right)
```
